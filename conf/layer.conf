## conf/layer.conf
```bitbake
BBPATH .= ":${LAYERDIR}"

BBFILES += "${LAYERDIR}/recipes-*/*/*.bb \
            ${LAYERDIR}/recipes-*/*/*.bbappend"

BBFILE_COLLECTIONS += "openauto"
BBFILE_PATTERN_openauto = "^${LAYERDIR}/"
BBFILE_PRIORITY_openauto = "7"

LAYERSERIES_COMPAT_openauto = "kirkstone"
```
